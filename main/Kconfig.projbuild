## main/Kconfig.projbuild
```kconfig
menu "Example Configuration"

config WIFI_SSID
    string "WiFi SSID"
	default ""
	help
		SSID (network name) for the example to connect to.

config WIFI_PASSWORD
    string "WiFi Password"
	default ""
	help
		WiFi password (WPA or WPA2) for the example to use.

		Can be left blank if the network has no security set.

config API_SERVER
    string "API Server"
  default "leons-mbp.fritz.box"

config API_PORT
    string "API Port"
  default "5000"

config API_URL
    string "API Url"
  default "https://leons-mbp.fritz.box:5000/api"

endmenu
```
